## meta-codesys-em/conf/layer.conf
```bitbake
# We have a conf and classes directory, add to BBPATH
BBPATH .= ":${LAYERDIR}"

# We have recipes-* directories, add to BBFILES
BBFILES += "${LAYERDIR}/recipes-*/*/*.bb \
            ${LAYERDIR}/recipes-*/*/*.bbappend \
           "

BBFILE_COLLECTIONS += "codesys-em"
BBFILE_PATTERN_codesys-em = "^${LAYERDIR}/"
BBFILE_PRIORITY_codesys-em = "16"
```

## meta-ememu/conf/layer.conf
```bitbake
# We have a conf and classes directory, add to BBPATH
BBPATH .= ":${LAYERDIR}"

# We have recipes-* directories, add to BBFILES
BBFILES += "${LAYERDIR}/recipes-*/*/*.bb \
            ${LAYERDIR}/recipes-*/*/*.bbappend \
           "

BBFILE_COLLECTIONS += "ememu-extras"
BBFILE_PATTERN_ememu-extras = "^${LAYERDIR}/"
BBFILE_PRIORITY_ememu-extras = "16"
```

## meta-ememu/conf/machine/ememu.conf
```bitbake
#@TYPE: Machine
#@NAME: ememu
#@DESCRIPTION: Machine configuration for Emicon emulator cpu47

require conf/machine/include/var-ti33x.inc
IMAGE_ROOTFS_ALIGNMENT = "2048"

IMAGE_CLASSES += "image_types_ememu"

# Should be same as BASENAME
IMAGE_NAME_VERSION ??= "${DATETIME}"
IMAGE_NAME = "${IMAGE_BASENAME}-${MACHINE}-${IMAGE_NAME_VERSION}"
IMAGE_NAME[vardepsexclude] = "IMAGE_NAME_VERSION"

IMAGE_FSTYPES += "ext3 sdcard-ememu"

SERIAL_CONSOLE = "115200;ttyS0"

# ignore arago psplash changes
BBMASK = "meta-arago/meta-arago-distro/recipes-core/psplash"

# UBI information.  Note that this is board and kernel specific.  Changes
# in your kernel port may require changes in these variables.  For more
# details about this board please see
# http://processors.wiki.ti.com/index.php/UBIFS_Support

# do ubiattach /dev/ubi_ctrl -m 7 -O 2048
# From dmesg:
# UBI: smallest flash I/O unit:    2048
# UBI: logical eraseblock size:    126976 bytes
# from ubiattach stdout:
# UBI device number 0, total 1988 LEBs
MKUBIFS_ARGS = "-F -m 2048 -e 126976 -c 4600"

# do ubiattach /dev/ubi_ctrl -m 7 -O 2048
# from dmesg:
# UBI: smallest flash I/O unit:    2048
# UBI: physical eraseblock size:   131072 bytes (128 KiB)
# UBI: sub-page size:              512
# UBI: VID header offset:          2048 (aligned 2048)
UBINIZE_ARGS = "-m 2048 -p 128KiB -s 512 -O 2048"

DISTRO_FEATURES_append = " bluez5"

MACHINE_FEATURES_remove = " wifi bluetooth wayland x11 bluez5"

IMAGE_INSTALL_append = " libstdc++ htop codesys openssh ememu-extras netcat tcpdump"

#Extras size (in KB) 200M !!!!!!!!!!!! temporary !!!!!!!!!!!!
#IMAGE_ROOTFS_EXTRA_SPACE = "204800"

IMAGE_ROOTFS = "${DEPLOY_DIR_IMAGE}/rootfs"

KERNEL_DEVICETREE_ememu = "vexpress-v2p-ca9.dtb"

PREFERRED_PROVIDER_virtual/kernel_ememu = "linux-ti-variscite"
PREFERRED_PROVIDER_virtual/bootloader_ememu = "u-boot-var-som-am33"
PREFERRED_PROVIDER_u-boot_ememu = "u-boot-var-som-am33"
```

## meta-variscite-amx3-em/conf/machine/emcpu47.conf
```bitbake
#@TYPE: Machine
#@NAME: emcpu47
#@DESCRIPTION: Machine configuration for Emicon cpu47

CUSTOM_IMAGE_VER = "4.2"

require conf/machine/include/emcpu47.inc

KERNEL_DEVICETREE_emcpu47 = "emcpu47.dtb var-som-am33.dtb"
KERNEL_DEVICETREE_NAND = "emcpu47.dtb"

PREFERRED_PROVIDER_virtual/kernel_emcpu47 = "linux-ti-variscite"
PREFERRED_PROVIDER_virtual/bootloader_emcpu47 = "u-boot-var-som-am33"
PREFERRED_PROVIDER_u-boot_emcpu47 = "u-boot-var-som-am33"
```

## meta-variscite-amx3-em/conf/machine/emcpu47n1g.conf
```bitbake
#@TYPE: Machine
#@NAME: emcpu47n1g
#@DESCRIPTION: Machine configuration for Emicon cpu47

CUSTOM_IMAGE_VER = "4.2"

require conf/machine/include/emcpu47.inc

KERNEL_DEVICETREE_emcpu47n1g = "emcpu47n1g.dtb var-som-am33.dtb"
KERNEL_DEVICETREE_NAND = "emcpu47n1g.dtb"

MKUBIFS_ARGS = "-F -m 4096 -e 504KiB -c 2000"
UBINIZE_ARGS = "-m 4096 -p 512KiB -s 4096 -O 4096"

PREFERRED_PROVIDER_virtual/kernel_emcpu47n1g = "linux-ti-variscite"
PREFERRED_PROVIDER_virtual/bootloader_emcpu47n1g = "u-boot-var-som-am33"
PREFERRED_PROVIDER_u-boot_emcpu47n1g = "u-boot-var-som-am33"
```

## meta-variscite-amx3-em/conf/machine/emcpu47n1g2.conf
```bitbake
#@TYPE: Machine
#@NAME: emcpu47n1g2
#@DESCRIPTION: Machine configuration for Emicon cpu47

CUSTOM_IMAGE_VER = "4.2"

require conf/machine/include/emcpu47.inc

KERNEL_DEVICETREE_emcpu47n1g2 = "emcpu47n1g2.dtb var-som-am33.dtb"
KERNEL_DEVICETREE_NAND = "emcpu47n1g2.dtb"

PREFERRED_PROVIDER_virtual/kernel_emcpu47n1g2 = "linux-ti-variscite"
PREFERRED_PROVIDER_virtual/bootloader_emcpu47n1g2 = "u-boot-var-som-am33"
PREFERRED_PROVIDER_u-boot_emcpu47n1g2 = "u-boot-var-som-am33"

MKUBIFS_ARGS = "-F -m 4096 -e 248KiB -c 4000"
UBINIZE_ARGS = "-m 4096 -p 256KiB -s 4096 -O 4096"
```
